## CMakeLists.txt
```
cmake_minimum_required(VERSION 3.20.0)

find_package(Zephyr REQUIRED HINTS $ENV{ZEPHYR_BASE})
project(tinychirp)

# Set via env vars: sysbuild doesn't forward arbitrary -D args to the app image.
set(MODEL       "$ENV{MODEL}"       CACHE STRING "" FORCE)
set(MEL_BACKEND "$ENV{MEL_BACKEND}" CACHE STRING "" FORCE)

target_compile_options(app PRIVATE -Wa,-I${CMAKE_CURRENT_SOURCE_DIR}/src/nrf)
target_include_directories(app PRIVATE src/nrf)

if(MODEL STREQUAL "sincnet_chunked")
    # Raw audio in, sincnet_chunked Axon model, no mel preprocessing.
    target_sources(app PRIVATE
        src/nrf/main_sincnet.c
        src/nrf/sample_input_sincnet.c
    )
else()
    # Default: cnn_mel path (optionally with on-device mel compute).
    target_sources(app PRIVATE
        src/nrf/main.c
        src/nrf/sample_input_raw.c
    )
    if(MEL_BACKEND)
        target_compile_definitions(app PRIVATE MEL_FROM_RAW)
        target_sources(app PRIVATE src/nrf/mel_compute.c)

        if(MEL_BACKEND STREQUAL "cpu")
            target_compile_definitions(app PRIVATE MEL_BACKEND_CPU)
            target_sources(app PRIVATE src/nrf/mel_fft_cpu.c)
        elseif(MEL_BACKEND STREQUAL "axon")
            target_compile_definitions(app PRIVATE MEL_BACKEND_AXON)
            target_sources(app PRIVATE src/nrf/mel_fft_axon_split.c)
        else()
            message(FATAL_ERROR "MEL_BACKEND must be 'cpu' or 'axon' (got '${MEL_BACKEND}')")
        endif()
    endif()
endif()
```

## prj.conf
```kconfig
CONFIG_NCS_SAMPLES_DEFAULTS=y

# cnn_mel needs 72960; sincnet_chunked needs 353280. nRF54LM20B has 511 KB SRAM,
# so a 360000-byte interlayer covers both with headroom.
CONFIG_NRF_AXON=y
CONFIG_NRF_AXON_INTERLAYER_BUFFER_SIZE=360000
CONFIG_NRF_AXON_PSUM_BUFFER_SIZE=0

CONFIG_PICOLIBC_IO_FLOAT=y
CONFIG_MAIN_STACK_SIZE=4096

# CMSIS-DSP for the mel_cpu backend (1024-pt rfft on the Cortex-M33).
CONFIG_CMSIS_DSP=y
CONFIG_CMSIS_DSP_TRANSFORM=y
CONFIG_CMSIS_DSP_COMPLEXMATH=y
```

## boards/nrf54lm20dk_nrf54lm20b_cpuapp.overlay
```dts
&axon {
    status = "okay";
};
```

## src/main.c
```c
#include <assert.h>
#include <string.h>

#include <zephyr/kernel.h>
#include <zephyr/sys/printk.h>

#include <axon/nrf_axon_platform.h>
#include <drivers/axon/nrf_axon_nn_infer.h>

#include "generated/nrf_axon_model_cnn_mel_.h"
#include "sample_input.h"

#ifdef MEL_FROM_RAW
#include "mel_compute.h"
static int8_t mel_buf_int8[MEL_TARGET_FRAMES * MEL_NUM_BINS];
#define BACKEND_NAME mel_backend_name
#else
#define BACKEND_NAME "baked"
#endif

static uint64_t cycles_to_us(uint32_t cycles)
{
	return k_cyc_to_ns_floor64(cycles) / 1000;
}

int main(void)
{
	if (nrf_axon_platform_init() || nrf_axon_nn_model_init_vars(&model_cnn_mel)) {
		printk("axon init failed\n");
		return -1;
	}

	printk("\n  cnn_mel | mel backend: %s | %d clips x %d frames x %d bins\n\n",
	       BACKEND_NAME, N_SAMPLE_CLIPS, MEL_TARGET_FRAMES, MEL_NUM_BINS);
	printk("  #  expected    pred  score(nt) / score(t)  -> result      pre        inf\n");

	const float s = (float)model_cnn_mel.output_dequant_mult /
	                (float)(1U << model_cnn_mel.output_dequant_round);
	const int32_t zp = model_cnn_mel.output_dequant_zp;

	uint64_t total_pre_us = 0;
	uint64_t total_inf_us = 0;

	for (int i = 0; i < N_SAMPLE_CLIPS; i++) {
		const sample_clip_t *c = &g_sample_clips[i];

		uint64_t pre_us = 0;
		const int8_t *model_input;
#ifdef MEL_FROM_RAW
		const uint32_t t_pre = k_cycle_get_32();
		if (mel_compute(c->audio, mel_buf_int8)) {
			printk("  %d  %-10s  mel_compute failed\n", i, c->label);
			continue;
		}
		pre_us = cycles_to_us(k_cycle_get_32() - t_pre);
		model_input = mel_buf_int8;
#else
		model_input = c->mel_baked;
#endif

		int32_t out_q[2];
		const uint32_t t_inf = k_cycle_get_32();
		nrf_axon_nn_model_infer_sync(&model_cnn_mel,
		                             (int8_t *)model_input, (int8_t *)out_q);
		const uint64_t inf_us = cycles_to_us(k_cycle_get_32() - t_inf);

		const float a = (out_q[0] - zp) * s;
		const float b = (out_q[1] - zp) * s;
		const char *pred = (b > a) ? "target" : "non_target";
		const char *mark = (strcmp(pred, c->label) == 0) ? "ok " : "BAD";

		printk("  %d  %-10s  %s  %7.3f / %7.3f  -> %-10s  %5llu ms  %5llu us\n",
		       i, c->label, mark, (double)a, (double)b, pred,
		       (unsigned long long)(pre_us / 1000),
		       (unsigned long long)inf_us);

		total_pre_us += pre_us;
		total_inf_us += inf_us;
	}

	printk("                                          avg %5llu ms  %5llu us\n",
	       (unsigned long long)(total_pre_us / N_SAMPLE_CLIPS / 1000),
	       (unsigned long long)(total_inf_us / N_SAMPLE_CLIPS));
	return 0;
}
```

## src/mel_axon.c
```c
#include <math.h>
#include <stdint.h>
#include <string.h>

#include <zephyr/sys/printk.h>

#include <drivers/axon/nrf_axon_dsp_intrinsics.h>
#include <drivers/axon/nrf_axon_driver.h>

#include "sample_input.h"
#include "mel_axon.h"

#ifndef MEL_FROM_RAW
#error "mel_axon.c requires MEL_FROM_RAW; data symbols are guarded by it."
#endif

#define XTY_CHUNK 512
#define VEC_CAP   512

#define ROUND_WINDOW 8
#define ROUND_FFT    0
#define ROUND_MEL    15
#define MEL_RADIX_BITS 12

#define POLL NRF_AXON_SYNC_MODE_BLOCKING_POLLING

static int32_t fft_buf[2 * MEL_FRAME_LENGTH];
static int32_t power_buf[MEL_FFT_BINS];
static int32_t mag_buf[MEL_FFT_BINS];
static int32_t mel_buf[MEL_NUM_BINS];
static int32_t mel_q1112[MEL_NUM_BINS];
static int32_t log_q1112[MEL_NUM_BINS];

static int compute_one_frame(const int16_t *frame_in, int32_t *mel_out)
{
	nrf_axon_result_e r;

	r = axon_xty_16_16_32_output_stride(
		&frame_in[0], &g_hann_window_q15[0],
		&fft_buf[0], XTY_CHUNK, ROUND_WINDOW, 1, POLL, true);
	if (r) return r;
	r = axon_xty_16_16_32_output_stride(
		&frame_in[XTY_CHUNK], &g_hann_window_q15[XTY_CHUNK],
		&fft_buf[2 * XTY_CHUNK], XTY_CHUNK, ROUND_WINDOW, 1, POLL, true);
	if (r) return r;

	r = axon_memset_32_output_stride(0, &fft_buf[1], XTY_CHUNK, 1, POLL, true);
	if (r) return r;
	r = axon_memset_32_output_stride(0, &fft_buf[2 * XTY_CHUNK + 1],
	                                 XTY_CHUNK, 1, POLL, true);
	if (r) return r;

	for (int off = 0; off < 2 * MEL_FRAME_LENGTH; off += VEC_CAP) {
		int n = (off + VEC_CAP <= 2 * MEL_FRAME_LENGTH)
		            ? VEC_CAP : (2 * MEL_FRAME_LENGTH - off);
		r = axon_saturate_32_24(&fft_buf[off], &fft_buf[off], n, POLL, true);
		if (r) return r;
	}

	r = axon_fft_power_24(&fft_buf[0], &power_buf[0],
	                      MEL_FFT_LENGTH_LOG2, true,
	                      ROUND_FFT, POLL, true);
	if (r) return r;

	r = axon_sqrt_24(&power_buf[0], &mag_buf[0], MEL_FFT_BINS, POLL, true);
	if (r) return r;

	for (int m = 0; m < MEL_NUM_BINS; m++) {
		bool keep = (m < MEL_NUM_BINS - 1);
		r = axon_mar_16_24_32(
			&g_mel_matrix_q15[m * MEL_FFT_BINS], &mag_buf[0],
			&mel_out[m], MEL_FFT_BINS, ROUND_MEL, POLL, keep);
		if (r) return r;
	}
	return 0;
}

int mel_axon_compute(int8_t *out_int8)
{
	const float in_scale = g_input_quant_scale;
	const int32_t in_zp = g_input_quant_zp;
	const float log_offset = -(float)(MEL_RADIX_BITS - 12) * logf(2.0f);

	for (int f = 0; f < MEL_TARGET_FRAMES; f++) {
		const int16_t *frame_in =
			&g_sample_raw_audio[f * MEL_FRAME_STEP];

		int err = compute_one_frame(frame_in, mel_buf);
		if (err) {
			printk("mel_axon frame %d failed: %d\n", f, err);
			return err;
		}

		for (int m = 0; m < MEL_NUM_BINS; m++) {
			int32_t v = mel_buf[m];
			if (v < 1) v = 1;
			mel_q1112[m] = v;
		}

		nrf_axon_result_e r = axon_logn_11p12(
			mel_q1112, log_q1112, MEL_NUM_BINS, POLL, false);
		if (r) {
			printk("axon_logn_11p12 frame %d failed: %d\n", f, r);
			return r;
		}

		int8_t *row = &out_int8[f * MEL_NUM_BINS];
		for (int m = 0; m < MEL_NUM_BINS; m++) {
			float log_mel = (float)log_q1112[m] / 4096.0f + log_offset;
			int32_t q = (int32_t)lroundf(log_mel / in_scale) + in_zp;
			if (q < -128) q = -128;
			if (q > 127)  q = 127;
			row[m] = (int8_t)q;
		}
	}
	return 0;
}
```

## src/mel_axon.h
```c
#pragma once

#include <stdint.h>

int mel_axon_compute(int8_t *out_int8);
```

## src/mel_compute.h
```c
#pragma once

#include <stdint.h>

int mel_compute(const int16_t *audio, int8_t *out_int8);

int mel_fft_frame(const int16_t *frame_in, int32_t *power_out);

extern const float mel_fft_log_offset;
extern const char *const mel_backend_name;
```

## src/mel_fft_cpu.c
```c
#include <math.h>
#include <stdbool.h>
#include <stdint.h>

#include <arm_math.h>

#include "sample_input.h"
#include "mel_compute.h"

#define POWER_SHIFT_CPU  8

const float mel_fft_log_offset =
	(12.0f - 0.5f * (30.0f - (float)POWER_SHIFT_CPU)) * 0.69314718056f;

const char *const mel_backend_name = "cpu";

static const float   k_power_scale = 1.0f / (float)(1u << POWER_SHIFT_CPU);
static const int32_t k_int24_cap   = (1 << 23) - 1;

static arm_rfft_fast_instance_f32 rfft_inst;
static bool rfft_inited;

static float win_f[MEL_FRAME_LENGTH];
static float fft_out[MEL_FRAME_LENGTH];
static float power_f[MEL_FFT_BINS];

int mel_fft_frame(const int16_t *frame_in, int32_t *power_out)
{
	if (!rfft_inited) {
		if (arm_rfft_fast_init_f32(&rfft_inst, MEL_FRAME_LENGTH) != ARM_MATH_SUCCESS) {
			return -1;
		}
		rfft_inited = true;
	}

	for (int n = 0; n < MEL_FRAME_LENGTH; n++) {
		win_f[n] = (float)frame_in[n] * g_hann_f32[n];
	}

	arm_rfft_fast_f32(&rfft_inst, win_f, fft_out, 0);

	/* arm_rfft_fast_f32 packs DC at [0] and Nyquist at [1]; we drop Nyquist. */
	power_f[0] = fft_out[0] * fft_out[0];
	arm_cmplx_mag_squared_f32(&fft_out[2], &power_f[1], MEL_FFT_BINS - 1);

	for (int k = 0; k < MEL_FFT_BINS; k++) {
		int32_t q = (int32_t)lroundf(power_f[k] * k_power_scale);
		if (q > k_int24_cap)  q = k_int24_cap;
		if (q < -k_int24_cap) q = -k_int24_cap;
		power_out[k] = q;
	}
	return 0;
}
```

## src/sample_input.h
```c
#pragma once
#include <stdint.h>
#include <stddef.h>

#include "generated_data/sample_input_meta.h"

typedef struct {
	const int16_t *audio;       /* int16 PCM, MEL_AUDIO_LEN samples */
	const int8_t  *mel_baked;   /* int8 log-mel, MEL_TARGET_FRAMES * MEL_NUM_BINS */
	const char    *label;
} sample_clip_t;

extern const sample_clip_t g_sample_clips[N_SAMPLE_CLIPS];

#ifdef MEL_FROM_RAW
extern const int16_t g_hann_window_q15[];
extern const int16_t g_hann_even_q15[];
extern const int16_t g_hann_odd_q15[];
extern const float   g_hann_f32[];
extern const float   g_twiddle_f32[];
extern const int16_t g_mel_matrix_q15[];
extern const float   g_input_quant_scale;
extern const int32_t g_input_quant_zp;
#endif
```
